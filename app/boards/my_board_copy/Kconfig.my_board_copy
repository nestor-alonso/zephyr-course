## app/boards/my_board_copy/Kconfig.my_board_copy
```kconfig
# Copyright (c) 2025 Siratul Islam
# SPDX-License-Identifier: Apache-2.0

config BOARD_MY_BOARD_COPY
	select SOC_ESP32_WROOM_32UE_N4
	select SOC_ESP32_PROCPU if MY_BOARD_COPY_ESP32_PROCPU
	select SOC_ESP32_APPCPU if MY_BOARD_COPY_ESP32_APPCPU
```

## app/boards/my_board_copy/board.yml
```yaml
board:
  name: my_board_copy
  full_name: My Board based on a Copy
  vendor: nalonso
  socs:
    - name: esp32
```

## app/boards/my_board_from_scratch/Kconfig.defconfig
```kconfig
if BOARD_MY_BOARD_FROM_SCRATCH

config ESP32_USE_UNSUPPORTED_REVISION
	default y

endif # BOARD_MY_BOARD_FROM_SCRATCH
```

## app/boards/my_board_from_scratch/Kconfig.my_board_from_scratch
```kconfig
# Copyright (c) 2025 Siratul Islam
# SPDX-License-Identifier: Apache-2.0

config BOARD_MY_BOARD_FROM_SCRATCH
	select SOC_ESP32_WROOM_32UE_N4
	select SOC_ESP32_PROCPU if MY_BOARD_FROM_SCRATCH_ESP32_PROCPU
	select SOC_ESP32_APPCPU if MY_BOARD_FROM_SCRATCH_ESP32_APPCPU
```

## app/boards/my_board_from_scratch/board.yml
```yaml
board:
  name: my_board_from_scratch
  full_name: My Board using the from-scratch method
  vendor: nalonso
  socs:
    - name: esp32
```
